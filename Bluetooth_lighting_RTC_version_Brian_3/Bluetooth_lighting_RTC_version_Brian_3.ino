/*
2024.01.15 Brian
藍芽版本節律照明
需外接RTC模組
app 連上ESP32藍芽後, 自動校正ESP32 RTC時間
預設開啟節律模式
切換模式時, 自動關閉其他模式

*/

// 引入ESP32開發板的庫
#include <Arduino.h>
#include <BluetoothSerial.h>
#include <Wire.h>
#include <RTClib.h>
#include <cmath>

RTC_DS3231 rtc;
BluetoothSerial ESP_BT;
TaskHandle_t showmodeTask;
volatile bool shouldExitBluetoothTask = true;

// 四色燈pin腳
const int ledPin_yellow = 15;
const int ledPin_green = 2;
const int ledPin_red = 4;
const int ledPin_other = 23;

// RTC時間、節律相關變數
int hours, minutes;
bool circadianMode = true;
void getCurrentTime(int &hours, int &minutes);

//手機端藍芽資料輸出
int input;  //模式+資料值
int inputType;
int value;
unsigned int lifeTime;

int settingRow;  // pin value 設定位址 (第幾列)
int cmode[781][4] = {
 {0, 0, 12, 4}, //6:00
 {0, 0, 24, 8}, //6:01
 {0, 0, 36, 12}, //6:02
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 {0, 0, 0, 0}, //19:00
};

// 展式模式相關函數
int delay_per_minute;

void setup() {
  Serial.begin(9600);

  // RTC initialization
  if (!rtc.begin()) {
    Serial.println("Couldn't find RTC");
    while (1);
  }
  if (rtc.lostPower()) {
    Serial.println("RTC lost power, let's set the time!");
    rtc.adjust(DateTime(F(__DATE__), F(__TIME__)));
  }

  // Bluetooth initialization
  ESP_BT.begin("bluetooth_connect");
  // 加入一些延遲，確保BluetoothSerial正確初始化
  delay(1000);

  // pin mode setting
  pinMode(ledPin_yellow, OUTPUT);
  pinMode(ledPin_green, OUTPUT);
  pinMode(ledPin_red, OUTPUT);
  pinMode(ledPin_other, OUTPUT);

  // 在 setup 函數中創建一個任務，並指定它在 core 1 上運行
  xTaskCreatePinnedToCore(
    showmodeTaskFunction,   // 任務的函數
    "showmodeTask",         // 任務名稱
    10000,                    // 堆棧大小
    NULL,                     // 參數
    1,                        // 優先級
    &showmodeTask,          // 任務句柄
    1                         // 核心編號（0或1）
  );

  Serial.println("setup completed");
}


void loop() {
  if (ESP_BT.available()) {
    // byte buffer[2];
    // ESP_BT.readBytes(buffer, 2);
    input = Bytes2num_to_int();
    // 手機傳輸資料類型(模式) / 資料值(模式設定)
    inputType = input / 100;
    value = input % 100;

    Serial.print("mode: "); 
    Serial.println(inputType);

    //mode recognition
    switch (inputType) {
      //RTC與手機同步時間, app詳見[BT_list.AfterPicking] block
      case 1:  
        Serial.println("synchronize time");
        // 接收來自app的Bytes list 資料
        byte currentTime[8];
        ESP_BT.readBytes(currentTime, 8);
        for (int i=0; i<6; i++){
          Serial.println(currentTime[i]);
        }

        // 設定RTC日期, 時間
        rtc.adjust(DateTime(2000+currentTime[0], currentTime[1], currentTime[2], currentTime[3], currentTime[4], currentTime[5]));

        Serial.println("synchronize time completed");
        print_current_time();
        break;


      // 節律模式開 / 關
      // 不在此做四色光的更新, 改在switch後執行 if(circadianMode)...
      case 2:  
        if (value == 1) {
          circadianMode = true;
          Serial.println("open circadian mode");
        }
        else {
          circadianMode = false;
          // write_four_pin(0,0,0,0);   不知要不要加 沒事可刪?????????
          // analogWrite(ledPin_yellow, 0);  delete
          // analogWrite(ledPin_green, 0);
          // analogWrite(ledPin_red, 0);
          // analogWrite(ledPin_other, 0);
          Serial.println("close circadian mode");
        }

        break;


      // 獨立控制模式
      case 3:  
        Serial.println("open control mode");
        byte fourPinvalue[4];
        ESP_BT.readBytes(fourPinvalue, 4);
        for (int i=0; i<4; i++){
          Serial.println(fourPinvalue[i]);
        }

        write_four_pin(fourPinvalue[0], fourPinvalue[1], fourPinvalue[2], fourPinvalue[3]);
        // analogWrite(ledPin_yellow, fourPinvalue[0]);  delete
        // analogWrite(ledPin_green, fourPinvalue[1]);
        // analogWrite(ledPin_red, fourPinvalue[2]);
        // analogWrite(ledPin_other, fourPinvalue[3]);

        break;


      // 循環展示模式
      // 循環中隨時監聽中斷訊號
      // 401 開啟循環模式 / 400關閉循環模式
      case 4:  
        if (value == 1) {
          Serial.println("open show mode");

          // 接收循環時間
          lifeTime = Bytes2num_to_int();
          Serial.print("循環時間: ");
          Serial.print(lifeTime);
          Serial.println(" 秒");
          // delay per minute
          int rows = sizeof(cmode) / sizeof(cmode[0]);
          delay_per_minute = lifeTime * 1000 / rows;
          // Serial.println(delay_per_minute);

          // 副任務判斷執行與否之旗幟, 設否為不中斷, 執行副任務
          shouldExitBluetoothTask = false;
        }
        else if (value == 0) {
          Serial.println("interrupt show mode");
          // 副任務判斷執行與否之旗幟
          shouldExitBluetoothTask = true;
        }

        break;


      // 調整色溫、亮度模式
      case 5:
        Serial.println("open color mode");
        byte light_color_setting[3];
        ESP_BT.readBytes(light_color_setting, 3);
        for (int i=0; i<3; i++) {
          Serial.println(light_color_setting[i]);
        }
        int inputcolorTemp = light_color_setting[0] * 100 + light_color_setting[1];
        int fourPin[4];
        get_pin_val_from_lightcolor(fourPin, inputcolorTemp, light_color_setting[2]);   // 色溫, 亮度    
        write_four_pin(fourPin[0], fourPin[1], fourPin[2], fourPin[3]);

        // Serial.println("色溫 亮度:");
        // Serial.println(inputcolorTemp);
        // Serial.println(light_color_setting[2]);
        Serial.println("燈珠pin值:");
        Serial.println(fourPin[0]);
        Serial.println(fourPin[1]);
        Serial.println(fourPin[2]);
        Serial.println(fourPin[3]);

        break;

    }
  }

  // 若打開節律模式, 則執行以下, 實現四色光隨RTC時間變色
  if (circadianMode) {
    getCurrentTime(hours, minutes);
    // 印出時間
    Serial.print("Current Time: ");
    Serial.print(hours);
    Serial.print(":");
    Serial.println(minutes);

    if (hours >= 6 && hours < 19) {
      settingRow = (hours-6) * 60 + minutes;
      write_four_pin(cmode[settingRow][0], cmode[settingRow][1], cmode[settingRow][2], cmode[settingRow][3]);
      // analogWrite(ledPin_yellow, cmode[settingRow][0]);  delete
      // analogWrite(ledPin_green, cmode[settingRow][1]);
      // analogWrite(ledPin_red, cmode[settingRow][2]);
      // analogWrite(ledPin_other, cmode[settingRow][3]);
      Serial.println("update circadian light, pin value: ");

      // Serial.println(settingRow);
      // Serial.println(cmode[settingRow][0]);
      // Serial.println(cmode[settingRow][1]);
      // Serial.println(cmode[settingRow][2]);
      // Serial.println(cmode[settingRow][3]);
    }
    else {
      write_four_pin(0,0,0,0);
      // analogWrite(ledPin_yellow, 0);  delete
      // analogWrite(ledPin_green, 0);
      // analogWrite(ledPin_red, 0);
      // analogWrite(ledPin_other, 0);
      Serial.println("now is at circadian night");
    }
    delay(1000);
  }


}


// 讀取RTC現在時間的函數
void getCurrentTime(int &hours, int &minutes) {
  DateTime now = rtc.now();
  hours = now.hour();
  minutes = now.minute();
}


int Bytes2num_to_int() {
  int input;
  byte buffer[2];
  ESP_BT.readBytes(buffer, 2);
  input = (buffer[1] << 8) | buffer[0];
  return input;
}


void print_current_time() {
  getCurrentTime(hours, minutes);
  Serial.print(hours);
  Serial.print(":");
  Serial.println(minutes);
}